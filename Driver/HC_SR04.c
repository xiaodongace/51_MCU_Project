/*========================================================================
 *  HC_SR04.c - HC-SR04 超声波测距
 *
 *  【2026-09-22 整体重写】直接照抄上课代码：
 *    D:/TooL/Share_SyncHome/嵌入式4阶段/stc8上课代码/05_小车/05_小车_超声波
 *    Driver/Ultrasonic.c
 *
 *  照抄了什么（一字不改）：
 *    · Delay10us() 的实现与 i = 78 这个初值
 *    · 触发脉冲：TRIG 拉高两个 10us（共 20us）再拉低
 *    · 两个等待循环的形状、计数方式、超时阈值（500 / 3000）
 *    · 状态码设计：0 = 成功、-1 = 等起跳超时、-2 = 高电平超时
 *    · 换算公式的物理含义：cnt x 0.01ms x 34cm/ms / 2
 *
 *  只做了两处必要适配（都不是"改算法"）：
 *    1. 引脚：它用 P4.7/P3.3（小车板），本工程是 P2.4/P3.6（扩展板）。
 *    2. float -> 定点整数：它的 *distance 是 float，本工程只剩 3.3KB
 *       程序空间，链不起浮点库（约 1.8KB）。换算完全相同：
 *           它：  ((cnt * 0.01) * 34) / 2   = cnt * 0.17
 *           本工程： cnt * 17 / 100
 *
 *  顺带记下前两版失败的原因，免得以后又想"优化"回去：
 *    · 第 1 版用 NOP 拼延时，实际 1.96us 当成 1us，读数只有真实的一半；
 *    · 第 2 版用 Timer4，但 T4_Load(0) 清不了正在跑的计数器，
 *      读数逐次累加，最后偏大 3 倍。
 *  上课代码的写法没有这两个问题，因为它的延时是**紧凑的 DJNZ 空转**
 *  （循环开销占比小），而且它不依赖"写寄存器去清零计数器"这件事。
 *========================================================================*/

#include "HC_SR04.h"

/* 中值滤波的历史 */
static u16 s_hist[SR04_FILTER_N];
static u8  s_histIdx = 0;
static u8  s_histCnt = 0;

/* 【2026-09-22 清理】原来这里有个 static u16 s_lastRaw; —— 记录
 * 最后一次测量的原始计数，供屏上 "RAW nnnn" 显示与一次标定。
 * 用户要求去掉 RAW 显示后它没有读者了，已删除。
 * 标定办法见 HC_SR04.h 的注释（要恢复只需 3 行代码）。 */

/*========================================================================
 *  照抄自上课代码 Driver/Ultrasonic.c 的 Delay10us()
 *
 *  【重要】不要改 i 的值、也不要改成 static。
 *    · i = 78 是 STC-ISP 按 24MHz 算出来的：Keil 把 while(--i) 编成
 *      DJNZ（3 时钟/圈），78 x 3 = 234 时钟 = 9.75us，就是注释说的 10us。
 *    · 不加 static：保留 LCALL/RET 的固定开销，时序与上课代码一致。
 *      （加了 static 编译器可能内联，时序会变。）
 *  本工程全工程搜过，没有别的 Delay10us 符号，不会链接冲突。
 *========================================================================*/
void Delay10us(void)    /* @24.000MHz */
{
    unsigned char data i;

    i = 78;
    while (--i);
}

/*========================================================================
 *  初始化 / 收尾
 *========================================================================*/
void SR04_Init(void)
{
    /* TRIG  P2.4  推挽输出（和上课代码一样：要给模块一个干净的高低电平） */
    P2_MODE_OUT_PP(GPIO_Pin_4);

    /* TRIG 先拉低：模块要求平时保持低电平，避免误触发 */
    SR04_TRIG = 0;

    /* ECHO  P3.6  高阻输入（和上课代码一样，见它 Ultrasonic_init 里的注释） */
    P3_MODE_IN_HIZ(GPIO_Pin_6);
}

void SR04_Stop(void)
{
    /* 本版本不用定时器、不用中断，所以"收尾"只是不发波。
     * （用 Timer4 的那一版要在这里停定时器；现在 Timer4 已经释放了。）*/
    SR04_TRIG = 0;
}

/*========================================================================
 *  读一次原始计数
 *
 *  返回： 0 = 成功（*out 是计数）
 *        -1 = 等 ECHO 起跳超时（500 x 10us = 5ms）  模块没插 / 没回波
 *        -2 = ECHO 高电平超时（3000 x 10us = 30ms）  太远（> 5 米）
 *
 *  【为什么用状态码而不是"返回 0 表示失败"】
 *    因为 cnt 本身也可能是 0（理论上），用数值没法区分"成功但 cnt=0"
 *    和"失败"。上课代码就是这么设计的（它返回 char），照抄。
 *========================================================================*/
static s8 sr04_read_raw(u16 *out)
{
    u16 cnt;

    /* ---- 1. 发触发脉冲：至少 10us 高，这里给两个 10us = 20us ---- */
    SR04_TRIG = 1;
    Delay10us();
    Delay10us();
    SR04_TRIG = 0;

    /* ---- 2. 等 ECHO 变高（模块开始回波）----
     * 上课代码的注释原文：
     *   "假如超过 500 * 10 = 5000us 都没有变为高电平
     *    (防止没有插上超声波模块，导致程序卡死)，也要退出循环"
     * 这就是**超时保护**，必须有 —— 上一版参考工程里的 HC_sr04.c
     * 用的是 while(ECHO==0); 死等，模块没插就永远卡住。 */
    cnt = 0U;
    while (SR04_ECHO == 0 && cnt < SR04_EDGE_CNT_MAX)
    {
        cnt++;
        Delay10us();
    }
    if (cnt >= SR04_EDGE_CNT_MAX)
    {
        *out = cnt;                 /* = 500：超时值的具体含义见 HC_SR04.h */
        return -1;
    }

    /* ---- 3. 数 ECHO 高电平的时间 ----
     * 上课代码的注释原文：
     *   "如果 cnt 达到了 3000，如果高电平超过了 30ms，
     *    说明目标太远了（大于 5 米），没有回波" */
    cnt = 0U;
    while (SR04_ECHO == 1 && cnt < SR04_ECHO_CNT_MAX)
    {
        cnt++;
        Delay10us();
    }
    if (cnt >= SR04_ECHO_CNT_MAX)
    {
        *out = cnt;                 /* = 3000：超时值，含义见 HC_SR04.h */
        return -2;
    }

    *out = cnt;
    return 0;
}

/*========================================================================
 *  中值滤波：对"原始计数"取中值
 *
 *  为什么对计数而不是对厘米数滤波：换算是线性比例，先滤波再换算
 *  少一次整数截断，更准。而且计数是原始量，滤波不会掩盖换算问题。
 *
 *  排序用最朴素的插入排序 —— 只有 5 个元素，不值得引库函数。
 *  （插入排序对已经接近有序的小数组很快。）
 *========================================================================*/
static u16 sr04_median(u16 now)
{
    u16 tmp[SR04_FILTER_N];
    u16 t;
    u8  i, j;

    /* 存进环形历史 */
    s_hist[s_histIdx] = now;
    s_histIdx++;
    if (s_histIdx >= SR04_FILTER_N)
    {
        s_histIdx = 0U;
    }
    if (s_histCnt < SR04_FILTER_N)
    {
        s_histCnt++;
    }

    /* 拷出来排序（不动历史本身） */
    for (i = 0; i < s_histCnt; i++)
    {
        tmp[i] = s_hist[i];
    }

    /* 插入排序：j 是有符号之外最朴素的做法 —— 注意用 j > 0 而不是 j >= 0，
     * j 是 u8，写 j >= 0 会恒真、死循环（这是本工程踩过的坑）。 */
    for (i = 1U; i < s_histCnt; i++)
    {
        t = tmp[i];
        j = i;
        while (j > 0U && tmp[j - 1U] > t)
        {
            tmp[j] = tmp[j - 1U];
            j--;
        }
        tmp[j] = t;
    }

    return tmp[s_histCnt / 2U];
}

/*========================================================================
 *  对外：测一次距离
 *
 *  返回 cm；0 表示本次没测到。
 *  【2026-09-22】失败原因仍由内部 sr04_read_raw() 的返回值区分
 *  （-1 = 等起跳超时、-2 = 高电平超时），只是当前没有对外暴露 ——
 *  屏上不再显示原始计数了（用户要求）。要恢复见 HC_SR04.h。
 *========================================================================*/
u16 SR04_Measure(void)
{
    u16 raw = 0U;
    u16 med;
    u16 cm100;
    u16 cm;
    s8  res;

    res = sr04_read_raw(&raw);

    if (res != 0)
    {
        return 0U;                  /* -1 / -2：本次失败，不进滤波历史 */
    }

    /* 量程判断（和上课代码一致：2 ~ 400cm）。用**本次**的 raw 判，
     * 不用滤波值 —— 否则一次远距离的越界读数会被历史"平均"成合法值。
     *
     * ※ 用 u16 而不是 u32：raw 最大 3000（超时值），x5 = 15000，
     *   远小于 65535，不会溢出。用 u32 会链入 ?C?LIMUL / ?C?ULDIV
     *   两个 32 位乘除库函数（几十字节 Flash + 慢得多），没必要。 */
    cm100 = (u16)(raw * SR04_CM_NUM);
    cm    = (u16)((cm100 + (SR04_CM_DEN / 2U)) / SR04_CM_DEN);   /* 四舍五入 */
    if (cm < SR04_CM_MIN || cm > SR04_CM_MAX)
    {
        return 0U;
    }

    /* 成功：进滤波历史，用中值换算最终结果 */
    med   = sr04_median(raw);
    cm100 = (u16)(med * SR04_CM_NUM);
    cm    = (u16)((cm100 + (SR04_CM_DEN / 2U)) / SR04_CM_DEN);   /* 四舍五入 */

    return cm;
}

void SR04_ResetFilter(void)
{
    u8 i;

    for (i = 0U; i < SR04_FILTER_N; i++)
    {
        s_hist[i] = 0U;
    }
    s_histIdx = 0U;
    s_histCnt = 0U;
}
