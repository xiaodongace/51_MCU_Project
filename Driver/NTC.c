/*
 * NTC.c - NTC 热敏电阻测温
 *
 * 查表数据逐字取自 v3.1 Driver/NTC.c 的 temp_table[]（见下方 TBL 段落，
 * 由脚本从原文件原样搬入，没有重打一个数字）。
 *
 * 算法与原版等价，只是把浮点换成整数：
 *
 *   原版（v3.1，浮点）                        本工程（整数）
 *   ntc_V = adc * 2.5 / 4096                  mv    = adc * 2500 / 4096        [毫伏]
 *   ntc_R = ntc_V * 10 / (3.3 - ntc_V)        rX100 = mv * 10 * 100 / (3300 - mv)
 *                                             rX100 的单位是"百分之一千欧"
 *   search_temp(ntc_R * 100) - 55             search_temp(rX100) - 55
 *
 *   等式两边一一对应，结果同值。
 *
 * 关于整数溢出的核算：
 *   adc 最大 4095 -> adc * 2500 = 10,237,500 需 32 位（u32 中转）
 *   mv 最大 2500  -> mv * 1000  = 2,500,000  需 32 位
 *   分母 (3300 - mv) 最小为 800（mv 上限 2500），不会除零
 *   rX100 实际范围约 15 ~ 3125，落在 u16 内
 */
#include "NTC.h"
#include "GPIO.h"
#include "ADC.h"
#include "NVIC.h"

/* ==================== 电阻-温度对照表（逐字取自 v3.1） ==================== */
u16 code temp_table[]= {
	58354, // -55 0
	55464, // -54 1
	52698, // -53 2
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	32,    // 125
};

#define TBL_LEN     (sizeof(temp_table) / sizeof(temp_table[0]))
#define TBL_BASE    55      /* 下标 0 对应 -55℃，所以温度 = 下标 - 55 */

void NTC_Init(void)
{
    GPIO_InitTypeDef GPIO_InitStructure;

    /* 【第 70 轮朴素化】原来拆成一个只被调用一次的 static GPIO_config()，
     * 直接并回来，少一层跳转。 */
    GPIO_InitStructure.Pin  = NTC_GPIO_PIN;
    GPIO_InitStructure.Mode = GPIO_HighZ;       /* 模拟输入要高阻 */
    GPIO_Inilize(NTC_GPIO_PORT, &GPIO_InitStructure);
}

/*
 * 在对照表里找最接近的一项，返回下标。
 * 表是按阻值降序排的（低温阻值大），这里用"线性找最小绝对差"，
 * 与 v3.1 的 search_temp() 算法一致（表只有一百多项，线性扫描够快，且不依赖单调性）。
 */
static u8 search_temp(u16 rX100)
{
    u8  i;
    u8  minIdx = 0;
    u16 minDist;
    u16 dist;
    u16 v;

    v = temp_table[0];
    minDist = (rX100 > v) ? (u16)(rX100 - v) : (u16)(v - rX100);

    for (i = 1; i < (u8)TBL_LEN; i++)
    {
        v = temp_table[i];
        dist = (rX100 > v) ? (u16)(rX100 - v) : (u16)(v - rX100);

        if (dist < minDist)
        {
            minDist = dist;
            minIdx  = i;
        }
    }

    return minIdx;
}

/* 最近 4 次的采样，用于平均滤波 */
static s16 s_hist[4];
static u8  s_filled  = 0;       /* 历史里已填充的个数，最多 4 */
static u8  s_histIdx = 0;       /* 环形写入位置，仅在填满后使用 */

s16 NTC_GetTempX10(void)
{
    u16  adcValue;
    u32  mv;
    u32  rX100_32;
    u16  rX100;
    s16  temp;
    s32  sum;
    u8   i;

    /* 读 P0.4 / ADC 通道 12 的 12 位结果 */
    adcValue = Get_ADCResult(NTC_ADC_CH);

    /* 1) 换算成毫伏：adc * 2500 / 4096 */
    mv = ((u32)adcValue * NTC_VREF_MV) / NTC_ADC_FULL;

    /* 2) 欧姆定律算热敏电阻阻值：R = V * 10 / (3.3 - V)，单位仍是 mV -> kΩ
     *    mv * 10(kΩ) * 100(百分之一) / (3300 - mv) */
    if (mv >= (u32)NTC_VCC_MV)
    {
        /* 电压贴顶，说明接线异常（短路/未接），返回 0℃ 以外的哨兵值由上层显示 "--" */
        return -1000;
    }

    rX100_32 = ((u32)mv * NTC_SERIES_KOHM * 100UL) / ((u32)NTC_VCC_MV - mv);

    if (rX100_32 > 58354UL)     /* 超出表的最大阻值，取表头 */
    {
        rX100 = 58354;
    }
    else
    {
        rX100 = (u16)rX100_32;
    }

    /* 3) 查表 -> 温度（整数摄氏度） */
    temp = (s16)search_temp(rX100) - (s16)TBL_BASE;


    /* 4) 滑动平均，抑制跳变（《04》F1：温度要有滤波，数据不跳）
     *    先顺序填满 4 格，之后按环形覆盖；平均值始终只用"已填充"的格数算，
     *    避免刚上电时被历史里的 0 拉低。 */
    if (s_filled < 4)
    {
        s_hist[s_filled] = temp;
        s_filled++;
    }
    else
    {
        s_hist[s_histIdx] = temp;
        s_histIdx++;
        if (s_histIdx >= 4)
        {
            s_histIdx = 0;
        }
    }

    sum = 0;
    for (i = 0; i < s_filled; i++)
    {
        sum += s_hist[i];
    }

    /* 【真机修正】这里原来是 return (s16)(sum / s_filled)，
     * 返回的是"整数摄氏度"，但函数名和调用方约定的是"摄氏度 x 10"。
     * 于是 29℃ 被当成 2.9 显示成 "T2.9C"。
     * 查表本身只有整数精度，所以这里就是把整数度乘 10，不损失信息。 */
    return (s16)((sum / (s32)s_filled) * 10);
}
